## meta-uarttest/conf/layer.conf
```bitbake
# We have a conf and classes directory, add to BBPATH
BBPATH .= ":${LAYERDIR}"

# We have recipes-* directories, add to BBFILES
BBFILES += "${LAYERDIR}/recipes-*/*/*.bb \
            ${LAYERDIR}/recipes-*/*/*.bbappend"

BBFILE_COLLECTIONS += "meta-uarttest"
BBFILE_PATTERN_meta-uarttest = "^${LAYERDIR}/"
BBFILE_PRIORITY_meta-uarttest = "6"

LAYERDEPENDS_meta-uarttest = "core"
LAYERSERIES_COMPAT_meta-uarttest = "dunfell"
```
